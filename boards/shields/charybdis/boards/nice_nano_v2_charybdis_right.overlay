&pro_micro_spi {
    status = "okay";
    cs-gpios = <&gpio0 20 GPIO_ACTIVE_LOW>;

    trackball_pmw: trackball@0 {
        status = "okay";
        compatible = "pixart,pmw3610";
        reg = <0>;
        spi-max-frequency = <2000000>;
        irq-gpios = <&gpio0 6 (GPIO_ACTIVE_LOW | GPIO_PULL_UP)>;
        cpi = <3200>;
        evt-type = <INPUT_EV_REL>;
        x-input-code = <INPUT_REL_X>;
        y-input-code = <INPUT_REL_Y>;
    };
};

&trackball_split {
    device = <&trackball_pmw>;
    status = "okay";
};